## config/boards/shields/wing/Kconfig.defconfig
```kconfig
# Copyright (c) 2021 The ZMK Contributors
# SPDX-License-Identifier: MIT

if SHIELD_WING_LEFT

config ZMK_KEYBOARD_NAME
	default "the Wing"

config ZMK_SPLIT_ROLE_CENTRAL
	default y

endif

if SHIELD_WING_LEFT || SHIELD_WING_RIGHT

config ZMK_SPLIT
	default y

endif
```

## config/boards/shields/wing/Kconfig.shield
```kconfig
# Copyright (c) 2021 The ZMK Contributors
# SPDX-License-Identifier: MIT

config SHIELD_WING_LEFT
	def_bool $(shields_list_contains,wing_left)

config SHIELD_WING_RIGHT
	def_bool $(shields_list_contains,wing_right)
```

## config/west.yml
```yaml
manifest:
  remotes:
    - name: zmkfirmware
      url-base: https://github.com/spectrotation
  projects:
    - name: zmk
      remote: zmkfirmware
      revision: main
      import: app/west.yml
  self:
    path: config
```
